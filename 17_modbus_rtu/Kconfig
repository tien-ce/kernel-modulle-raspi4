## 17_modbus_rtu/Kconfig
```kconfig
menuconfig MODBUS_STACK
	tristate	"Modbus RTU Master Suport"
	help
		Enable this to support Modbus RTU protocol over RS485 for Raspberry Pi.
if MODBUS_STACK
	source "modbus_controller/Kconfig"
	source "modbus_device/Kconfig"
endif
```

## 17_modbus_rtu/modbus_controller/Kconfig
```kconfig
config MODBUS_RTU_CONTROLLER
	depends on MODBUS_STACK
    tristate "Modbus RTU Controller Driver"
	default m
    help
      The core controller managing the Modbus FSM and RS485 timing.
if MODBUS_RTU_CONTROLLER

choice 
	prompt "Modbus physical interface"
	default MODBUS_INTERFACE_UART
	help
		"Select the physical transport layer for Modbus RTU stack."
config MODBUS_INTERFACE_UART
	bool "UART (Serdev)"
	help
		Use the standard UART (via Serdev) as the Modbus transprt.

config MODBUS_INTERFACE_USB
	bool "USB-to-RS485"
	depends on USB
	help
		Use a USB-to-RS485 adapter as the Modbus transport.

endchoice

endif
```

## 17_modbus_rtu/modbus_device/Kconfig
```kconfig
config MODBUS_RTU_DEVICE
	depends on MODBUS_RTU_CONTROLLER
	tristate "Modbus RTU Device Support"
	default m
	help
	  Support for Modbus slave devices like CO and PM sensors.
	  Each device is exposed via /dev and sysfs.

if MODBUS_RTU_DEVICE

menu "PM Sensor Options"

config PM10
	bool "Include PM10 value register"
	default n
	help
	  Say Y if your PM sensor reports PM10 particle readings.
	  This adds a pm10_value sysfs attribute to the PM device node.
	  If unsure, say N.

endmenu

endif
```

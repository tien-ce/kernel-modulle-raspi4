/dts-v1/;
/plugin/;
&uart2 {
	/* Mod bus controller */
	modbus_controller {
		status = "okay";
		compatible = "serdev,modbus_controller";
		#address-cells = <1>;
        #size-cells = <0>;
		/* Define how children (sensors) are addressed */
		lsmy,baudrate = <9600>;
		/* Child node representing the CO Sensor */
		co_sensor@24 {
			status = "okay";
            compatible = "rs485,co_sensor";
            /* FIX: Use standard 'reg' property for the Slave ID */
            reg = <0x1>; 
            lsmy,reg-addresses = <0x0006>;
        };
		/* Child node representing the PM Sensor */
        pm_sensor@25 {
            compatible = "rs485,pm_sensor";
            reg = <0x24>;
            lsmy,reg-addresses = <0x0004 0x0009>;
        };
	};
};

/dts-v1/;
/plugin/;
/ {
	compatible = "brcm,bcm2711";
	fragment@0 {
		target-path = "/";
		__overlay__ {
			my_device {
				compatible = "brightlight,mydev";
				status = "okay";
				label = "Test";
				my_value = <12>;
				button-gpio = <&gpio 17 1>;
				led-gpio = <&gpio 18 0>;
			};
		};
	};
};